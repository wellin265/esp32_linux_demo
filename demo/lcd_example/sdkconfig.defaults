## demo/lcd_example/sdkconfig.defaults
```kconfig
# Bluetooth - Bluedroid BLE (not NimBLE)
CONFIG_BT_ENABLED=y
CONFIG_BT_BLE_ENABLED=y
CONFIG_BT_BLUEDROID_ENABLED=y
CONFIG_BT_CLASSIC_ENABLED=n
CONFIG_BT_CONTROLLER_ONLY=n
CONFIG_BT_CONTROLLER_ENABLED=y
CONFIG_BT_BLE_HOST_QUEUE_CONG_CHECK=n
CONFIG_BT_BLE_42_FEATURES_SUPPORTED=y
```

## ks_demo/01.basic.gpio/main/Kconfig.projbuild
```kconfig
menu "Example Configuration"

    comment "This demo uses fixed pins: IO5 input, IO19/IO20 outputs"

endmenu
```

## ks_demo/04.advanced.face_recognition/sdkconfig.defaults.esp32s3
```kconfig
CONFIG_ESP32S3_DEFAULT_CPU_FREQ_240=y
CONFIG_ESP32S3_SPIRAM_SUPPORT=y


CONFIG_CAMERA_MODULE_ESP_S3_EYE=y
CONFIG_ESPTOOLPY_NO_STUB=y
CONFIG_ESP_CONSOLE_USB_SERIAL_JTAG=y

# Codex unified esp32s3 defaults

# Codex unified esp32s3 defaults
CONFIG_IDF_TARGET_ARCH_XTENSA=y
CONFIG_IDF_TARGET_ARCH="xtensa"
CONFIG_IDF_TARGET="esp32s3"
CONFIG_IDF_TARGET_ESP32S3=y
CONFIG_ESPTOOLPY_FLASHMODE_QIO=y
CONFIG_ESPTOOLPY_FLASHSIZE_16MB=y
CONFIG_I2C_MASTER_SCL=18
CONFIG_I2C_MASTER_SDA=17
CONFIG_SPIRAM=y
CONFIG_SPIRAM_MODE_OCT=y
CONFIG_SPIRAM_SPEED_80M=y
CONFIG_ESP_DEFAULT_CPU_FREQ_MHZ_240=y
CONFIG_ESP32S3_INSTRUCTION_CACHE_32KB=y
CONFIG_ESP32S3_DATA_CACHE_64KB=y
CONFIG_ESP32S3_DATA_CACHE_LINE_64B=y
CONFIG_FATFS_LFN_STACK=y
CONFIG_FREERTOS_HZ=1000
CONFIG_MBEDTLS_EXTERNAL_MEM_ALLOC=y
```

## ks_demo/04.advanced.usb_camera_display/components/espressif__button/test_apps/sdkconfig.defaults
```kconfig
# For IDF 5.0
CONFIG_ESP_TASK_WDT_EN=n

# For IDF4.4
CONFIG_ESP32S2_DEFAULT_CPU_FREQ_240=y
CONFIG_ESP32S3_DEFAULT_CPU_FREQ_240=y
CONFIG_ESP_TASK_WDT=n

# Codex unified esp32s3 defaults

# Codex unified esp32s3 defaults
CONFIG_IDF_TARGET_ARCH_XTENSA=y
CONFIG_IDF_TARGET_ARCH="xtensa"
CONFIG_IDF_TARGET="esp32s3"
CONFIG_IDF_TARGET_ESP32S3=y
CONFIG_ESPTOOLPY_FLASHMODE_QIO=y
CONFIG_ESPTOOLPY_FLASHSIZE_16MB=y
CONFIG_I2C_MASTER_SCL=18
CONFIG_I2C_MASTER_SDA=17
CONFIG_SPIRAM=y
CONFIG_SPIRAM_MODE_OCT=y
CONFIG_SPIRAM_SPEED_80M=y
CONFIG_ESP_DEFAULT_CPU_FREQ_MHZ_240=y
CONFIG_ESP32S3_INSTRUCTION_CACHE_32KB=y
CONFIG_ESP32S3_DATA_CACHE_64KB=y
CONFIG_ESP32S3_DATA_CACHE_LINE_64B=y
CONFIG_FATFS_LFN_STACK=y
CONFIG_FREERTOS_HZ=1000
CONFIG_MBEDTLS_EXTERNAL_MEM_ALLOC=y
```
